## arch/powerpc/configs/mvme6100_defconfig
```kconfig
CONFIG_SYSVIPC=y
CONFIG_NO_HZ=y
CONFIG_HIGH_RES_TIMERS=y
CONFIG_LOG_BUF_SHIFT=14
CONFIG_BLK_DEV_INITRD=y
CONFIG_ALTIVEC=y
# CONFIG_PPC_CHRP is not set
# CONFIG_PPC_PMAC is not set
CONFIG_EMBEDDED6xx=y
CONFIG_MVME6100=y
CONFIG_HIGHMEM=y
# CONFIG_SECCOMP is not set
CONFIG_PARTITION_ADVANCED=y
CONFIG_NET=y
CONFIG_PACKET=y
CONFIG_UNIX=y
CONFIG_INET=y
CONFIG_IP_MULTICAST=y
CONFIG_IP_PNP=y
CONFIG_IP_PNP_DHCP=y
CONFIG_IP_PNP_BOOTP=y
CONFIG_SYN_COOKIES=y
# CONFIG_IPV6 is not set
CONFIG_MTD=y
CONFIG_MTD_BLOCK=y
CONFIG_MTD_CFI=y
CONFIG_MTD_JEDECPROBE=y
CONFIG_MTD_CFI_INTELEXT=y
CONFIG_BLK_DEV_LOOP=y
CONFIG_BLK_DEV_RAM=y
CONFIG_BLK_DEV_RAM_SIZE=131072
CONFIG_NETDEVICES=y
CONFIG_MV643XX_ETH=y
# CONFIG_INPUT_KEYBOARD is not set
# CONFIG_INPUT_MOUSE is not set
# CONFIG_SERIO is not set
CONFIG_SERIAL_8250=y
CONFIG_SERIAL_8250_CONSOLE=y
# CONFIG_HW_RANDOM is not set
CONFIG_I2C=y
CONFIG_I2C_CHARDEV=y
CONFIG_I2C_MV64XXX=y
CONFIG_USB=y
CONFIG_USB_EHCI_HCD=y
CONFIG_USB_OHCI_HCD=y
CONFIG_EXT2_FS=y
CONFIG_EXT3_FS=y
CONFIG_TMPFS=y
CONFIG_JFFS2_FS=y
CONFIG_NFS_FS=y
CONFIG_ROOT_NFS=y
```

## drivers/vme/Kconfig
```kconfig
# SPDX-License-Identifier: GPL-2.0-only
#
# VME configuration.
#

menuconfig VME_BUS
	bool "VME bridge support"
	depends on PCI
	help
	  Enable support for VME (VersaModular Eurocard bus) bridge modules.
	  The bridge allows connecting VME devices to systems with existing
	  interfaces (like USB or PCI) by means of translating VME protocol
	  operations.

	  Note that this only enables the bridge framework. You'll also
	  likely want to enable driver for specific bridge device you have
	  to actually use it. If unsure, say N.

if VME_BUS

source "drivers/vme/bridges/Kconfig"

source "drivers/vme/boards/Kconfig"

endif # VME
```

## drivers/vme/bridges/Kconfig
```kconfig
# SPDX-License-Identifier: GPL-2.0-only
comment "VME Bridge Drivers"

config VME_CA91CX42
	tristate "Universe II"
	depends on HAS_DMA
	help
	 If you say Y here you get support for the Tundra CA91C142
	 (Universe II) VME bridge chip.

config VME_TSI148
	tristate "Tundra TSI148 VME bridge support"
	depends on HAS_DMA
	help
	 If you say Y here you get support for the Tundra TSI148 VME-to-PCI/X
	 bridge chip (and pin-compatible clones).

	 TSI148 is a high-performant, 2eSST and VME64-compliant VME-to-PCI/X
	 interconnect bridge with support for PCI and PCI-X bus interface.
	 It is primarily used in industrial and embedded systems.

	 To compile this driver as a module, say M - the module will be
	 called vme_tsi148. If unsure, say N.

config VME_FAKE
	tristate "Fake"
	help
	 If you say Y here you get support for the fake VME bridge. This
	 provides a virtualised VME Bus for devices with no VME bridge. This
	 is mainly useful for VME development (in the absence of VME
	 hardware).
```
