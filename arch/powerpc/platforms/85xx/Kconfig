## arch/powerpc/platforms/85xx/Kconfig
```kconfig
choice
	prompt "Machine Type"
	depends on PPC_85xx
	default MVME3100

config MVME3100
	bool "Motorola MVME3100"
	select WANT_DEVICE_TREE
	help
	  This option enables support for the Motorola MVME3100 board

config MPC8540_ADS
	bool "Freescale MPC8540 ADS"
	select DEFAULT_UIMAGE
	help
	  This option enables support for the MPC 8540 ADS board

config MPC8560_ADS
	bool "Freescale MPC8560 ADS"
	select DEFAULT_UIMAGE
	help
	  This option enables support for the MPC 8560 ADS board

config MPC85xx_CDS
	bool "Freescale MPC85xx CDS"
	select DEFAULT_UIMAGE
	help
	  This option enables support for the MPC85xx CDS board

endchoice

config MPC8540
	bool
	select PPC_UDBG_16550
	select PPC_INDIRECT_PCI
	default y if MPC8540_ADS || MPC85xx_CDS || MVME3100

config MPC8560
	bool
	select CPM2
	default y if MPC8560_ADS

config MPC85xx
 	bool
 	select PPC_UDBG_16550
 	select PPC_INDIRECT_PCI if PCI 
 	select PPC_INDIRECT_PCI_BE if PCI
	select MPIC
	select FSL_PCI if PCI
 	select SERIAL_8250_SHARE_IRQ if SERIAL_8250
 	default y if MPC8540_ADS || MPC85xx_CDS || MPC8560_ADS \
 		|| MPC85xx_MDS || MPC8544_DS || MVME3100

config MVME3100_ENABLE_DDR_ERRORS
        bool "Enable DDR Error Reporting"
        depends on MVME3100
        default y

config MVME3100_ENABLE_L2_ERRORS
        bool "Enable L2 Error Reporting"
        depends on MVME3100
        default y

config MVME3100_ENABLE_PCI_ERRORS
        bool "Enable PCI Error Reporting"
        depends on MVME3100
        default y

config MVME3100_TICK_TIMERS
        bool "Enable support for the Tick Timers on the MVME3100"
        depends on MVME3100
        default y
```

## arch/powerpc/platforms/86xx/Kconfig
```kconfig
choice
	prompt "Machine Type"
	depends on PPC_86xx
	default MVME7100

config MVME7100
	bool "Motorola ECC MVME7100"
	select PPC_I8259
	select PPC_PCI_QUIRKS
	help
	  This option enables support for the Motorola ECC MVME7100 board.

config MPC8641_HPCN
	bool "Freescale MPC8641 HPCN"
	select PPC_I8259
	select PPC_PCI_QUIRKS
	help
	  This option enables support for the MPC8641 HPCN board.

endchoice

config MPC8641
	bool
        select PPC_INDIRECT_PCI_BE if PCI
	select FSL_PCI if PCI
	select PPC_UDBG_16550
	select MPIC
	default y if MPC8641_HPCN || MVME7100

config MVME7100_ENABLE_DDR_ERRORS
        bool "Enable DDR Error Reporting"
        depends on MVME7100
        default y

config MVME7100_ENABLE_L2_ERRORS
        bool "Enable L2 Error Reporting"
        depends on MVME7100
        default y

config MVME7100_ENABLE_PCI_ERRORS
        bool "Enable PCI Error Reporting"
        depends on MVME7100
        default y

config MVME7100_TICK_TIMERS
        bool "Enable support for the Tick Timers on the MVME7100"
        depends on MVME7100
        default y
```
